## config/boards/shields/alyx/Kconfig.defconfig
```kconfig
# Copyright (c) 2020 The ZMK Contributors
# SPDX-License-Identifier: MIT

if SHIELD_ALYX

config ZMK_KEYBOARD_NAME
    default "alyx"


config ZMK_BLE
    def_bool y

endif
```

## config/boards/shields/alyx2/Kconfig.defconfig
```kconfig
# Copyright (c) 2020 The ZMK Contributors
# SPDX-License-Identifier: MIT

if SHIELD_ALYX2

config ZMK_KEYBOARD_NAME
    default "alyx2"

endif
```

## config/boards/shields/alyx2/Kconfig.shield
```kconfig
# Copyright (c) 2020 The ZMK Contributors
# SPDX-License-Identifier: MIT

config SHIELD_ALYX2
    def_bool $(shields_list_contains,alyx2)
```

## config/west.yml
```yaml
manifest:
  remotes:
    - name: zmkfirmware
      url-base: https://github.com/zmkfirmware
    - name: alyx-brett
      url-base: https://github.com/alyx-brett
  projects:
    - name: zmk
      remote: zmkfirmware
      revision: main
      import: app/west.yml
    - name: kb_zmk_ps2_mouse_trackpoint_driver
      remote: alyx-brett
      revision: main
  self:
    path: config
```
